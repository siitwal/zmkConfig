## boards/shields/corne_display/Kconfig.defconfig
```kconfig
if SHIELD_CORNE_DISPLAY

choice ZMK_DISPLAY_WORK_QUEUE
    default ZMK_DISPLAY_WORK_QUEUE_DEDICATED
endchoice

choice ZMK_DISPLAY_STATUS_SCREEN
    default ZMK_DISPLAY_STATUS_SCREEN_CUSTOM
endchoice

config ZMK_DISPLAY_STATUS_SCREEN_CUSTOM
    imply CORNE_WIDGET_STATUS

config CORNE_WIDGET_STATUS
    bool "Custom corne status widget"
    select LV_USE_LABEL
    select LV_USE_IMG
    select LV_USE_CANVAS
    select LV_USE_ANIMIMG 
    select LV_USE_ANIMATION
    select LV_USE_LINE 
    select LV_FONT_UNSCII_8
    select ZMK_WPM

config LV_Z_VDB_SIZE
    default 64

config LV_DPI_DEF
    default 148

config LV_Z_BITS_PER_PIXEL
    default 1

config LV_Z_MEM_POOL_SIZE
    default 4096 if ZMK_DISPLAY_STATUS_SCREEN_CUSTOM

choice LV_COLOR_DEPTH
    default LV_COLOR_DEPTH_1
endchoice

endif
```
